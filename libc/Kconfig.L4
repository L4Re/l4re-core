## libc/Kconfig.L4
```kconfig
choice
  prompt "Libc variant"

config L4_LIBC_UCLIBC
  bool "uclibc-ng"

config L4_LIBC_MUSL
  bool "musl" if EXPERIMENTAL && (   BUILD_ARCH_arm64 || BUILD_ARCH_arm \
                                  || BUILD_ARCH_amd64 || BUILD_ARCH_x86)

endchoice

config L4_LIBC
  string
  default "uclibc-ng" if L4_LIBC_UCLIBC
  default "musl" if L4_LIBC_MUSL
```

## moe/Kconfig.L4
```kconfig
menu "Moe"
	visible if EXPERT

config MOE_DEBUG_NAMES
	bool "Set jdb names for created kernel objects"
	help
	  With this option enabled, Moe will register names in jdb for all
	  objects it creates.

	  This is a debugging and development feature.

config MOE_BOOT_FB
	bool "Pass-on the bootloader's frame buffer"
	default y
	help
	  Add support to expose the bootloader's frame buffer as special
	  dataspace.

	  If unsure, say y.

choice
	prompt "Page allocator"
	default MOE_PAGE_ALLOC_TREE

config MOE_PAGE_ALLOC_LIST
	bool "List-based page allocator"
	help
	  First-fit page allocator based on a linked list.

	  O(n) worst-case allocation complexity.
	  O(n) free complexity.

config MOE_PAGE_ALLOC_TREE
	bool "Tree-based page allocator"
	help
	  First-fit page allocator based on an AVL tree.

	  O(n log n) worst-case allocation complexity.
	  O(log n) free complexity.
	  It drastically improves page free performance with only minor allocation
	  performance overhead.

endchoice

endmenu
```

## sigma0/Kconfig.L4
```kconfig
menu "Sigma0 (root pager)"
	visible if EXPERT

config SIGMA0_PRIORITY
	int "Priority"
	range 1 255
	default 255
	help
	  This sets the priority the root pager runs with. The default
	  is the highest priority and is almost always the best fit.

	  Valid values range from 1 to 255.

config SIGMA0_HEAP_NUM_PAGES
	int "Number of page for heap"
	range 1 32 # arbitrary sane limit
	default 2
	help
	  This sets the number of pages used by the Sigma0 heap. The heap is
	  only used to track region lists for normal RAM, for I/O port (x86),
	  and for a static list of available MMIO regions.

	  Usually, the number of required regions is limited:
	  - The root task allocates the entire RAM.
	  - The number of MMIO regions is constant (no user tracking).

	  So the number of regions depends on the static RAM fragmentation, the
	  static fragmentation of the MMIO space and, on x86, the dynamically
	  variable number of I/O port regions.

endmenu
```
